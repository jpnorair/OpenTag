
/*
!!! Primary linker script file generated automatically !!!
This file contains the input and output files names
It also includes the secondary/main linker script that is specified in the Ride options (default or custom)
*/

SEARCH_DIR(".")
SEARCH_DIR("Z:\OpenTag\Repository\OpenTag_M2\Apps\Demo_Opmode\Proj_RIDE7")
SEARCH_DIR("C:\Program Files\Raisonance\Ride\Lib\ARM")
INPUT("Z:\OpenTag\Repository\OpenTag_M2\Apps\Demo_Opmode\Proj_RIDE7\startup_stm32f10x_xl.o")
INPUT("Z:\OpenTag\Repository\OpenTag_M2\Apps\Demo_Opmode\Proj_RIDE7\main.o")
INPUT("Z:\OpenTag\Repository\OpenTag_M2\Apps\Demo_Opmode\Proj_RIDE7\stm32f10x_it.o")
INPUT("Z:\OpenTag\Repository\OpenTag_M2\Apps\Demo_Opmode\Proj_RIDE7\system.o")
INPUT("Z:\OpenTag\Repository\OpenTag_M2\Apps\Demo_Opmode\Proj_RIDE7\alp_api_client.o")
INPUT("Z:\OpenTag\Repository\OpenTag_M2\Apps\Demo_Opmode\Proj_RIDE7\alp_api_server.o")
INPUT("Z:\OpenTag\Repository\OpenTag_M2\Apps\Demo_Opmode\Proj_RIDE7\alp_dashforth.o")
INPUT("Z:\OpenTag\Repository\OpenTag_M2\Apps\Demo_Opmode\Proj_RIDE7\alp_filedata.o")
INPUT("Z:\OpenTag\Repository\OpenTag_M2\Apps\Demo_Opmode\Proj_RIDE7\alp_logger.o")
INPUT("Z:\OpenTag\Repository\OpenTag_M2\Apps\Demo_Opmode\Proj_RIDE7\alp_main.o")
INPUT("Z:\OpenTag\Repository\OpenTag_M2\Apps\Demo_Opmode\Proj_RIDE7\alp_security.o")
INPUT("Z:\OpenTag\Repository\OpenTag_M2\Apps\Demo_Opmode\Proj_RIDE7\alp_sensor.o")
INPUT("Z:\OpenTag\Repository\OpenTag_M2\Apps\Demo_Opmode\Proj_RIDE7\auth.o")
INPUT("Z:\OpenTag\Repository\OpenTag_M2\Apps\Demo_Opmode\Proj_RIDE7\buffers.o")
INPUT("Z:\OpenTag\Repository\OpenTag_M2\Apps\Demo_Opmode\Proj_RIDE7\crc16.o")
INPUT("Z:\OpenTag\Repository\OpenTag_M2\Apps\Demo_Opmode\Proj_RIDE7\crypto_aes128.o")
INPUT("Z:\OpenTag\Repository\OpenTag_M2\Apps\Demo_Opmode\Proj_RIDE7\encode_M2.o")
INPUT("Z:\OpenTag\Repository\OpenTag_M2\Apps\Demo_Opmode\Proj_RIDE7\external.o")
INPUT("Z:\OpenTag\Repository\OpenTag_M2\Apps\Demo_Opmode\Proj_RIDE7\M2_network.o")
INPUT("Z:\OpenTag\Repository\OpenTag_M2\Apps\Demo_Opmode\Proj_RIDE7\M2QP.o")
INPUT("Z:\OpenTag\Repository\OpenTag_M2\Apps\Demo_Opmode\Proj_RIDE7\ndef.o")
INPUT("Z:\OpenTag\Repository\OpenTag_M2\Apps\Demo_Opmode\Proj_RIDE7\OT_utils.o")
INPUT("Z:\OpenTag\Repository\OpenTag_M2\Apps\Demo_Opmode\Proj_RIDE7\OTAPI_logger.o")
INPUT("Z:\OpenTag\Repository\OpenTag_M2\Apps\Demo_Opmode\Proj_RIDE7\queue.o")
INPUT("Z:\OpenTag\Repository\OpenTag_M2\Apps\Demo_Opmode\Proj_RIDE7\session.o")
INPUT("Z:\OpenTag\Repository\OpenTag_M2\Apps\Demo_Opmode\Proj_RIDE7\veelite.o")
INPUT("Z:\OpenTag\Repository\OpenTag_M2\Apps\Demo_Opmode\Proj_RIDE7\core_cm3.o")
INPUT("Z:\OpenTag\Repository\OpenTag_M2\Apps\Demo_Opmode\Proj_RIDE7\misc.o")
INPUT("Z:\OpenTag\Repository\OpenTag_M2\Apps\Demo_Opmode\Proj_RIDE7\stm32f10x_adc.o")
INPUT("Z:\OpenTag\Repository\OpenTag_M2\Apps\Demo_Opmode\Proj_RIDE7\stm32f10x_bkp.o")
INPUT("Z:\OpenTag\Repository\OpenTag_M2\Apps\Demo_Opmode\Proj_RIDE7\stm32f10x_can.o")
INPUT("Z:\OpenTag\Repository\OpenTag_M2\Apps\Demo_Opmode\Proj_RIDE7\stm32f10x_cec.o")
INPUT("Z:\OpenTag\Repository\OpenTag_M2\Apps\Demo_Opmode\Proj_RIDE7\stm32f10x_crc.o")
INPUT("Z:\OpenTag\Repository\OpenTag_M2\Apps\Demo_Opmode\Proj_RIDE7\stm32f10x_dac.o")
INPUT("Z:\OpenTag\Repository\OpenTag_M2\Apps\Demo_Opmode\Proj_RIDE7\stm32f10x_dbgmcu.o")
INPUT("Z:\OpenTag\Repository\OpenTag_M2\Apps\Demo_Opmode\Proj_RIDE7\stm32f10x_dma.o")
INPUT("Z:\OpenTag\Repository\OpenTag_M2\Apps\Demo_Opmode\Proj_RIDE7\stm32f10x_exti.o")
INPUT("Z:\OpenTag\Repository\OpenTag_M2\Apps\Demo_Opmode\Proj_RIDE7\stm32f10x_flash.o")
INPUT("Z:\OpenTag\Repository\OpenTag_M2\Apps\Demo_Opmode\Proj_RIDE7\stm32f10x_fsmc.o")
INPUT("Z:\OpenTag\Repository\OpenTag_M2\Apps\Demo_Opmode\Proj_RIDE7\stm32f10x_gpio.o")
INPUT("Z:\OpenTag\Repository\OpenTag_M2\Apps\Demo_Opmode\Proj_RIDE7\stm32f10x_i2c.o")
INPUT("Z:\OpenTag\Repository\OpenTag_M2\Apps\Demo_Opmode\Proj_RIDE7\stm32f10x_iwdg.o")
INPUT("Z:\OpenTag\Repository\OpenTag_M2\Apps\Demo_Opmode\Proj_RIDE7\stm32f10x_pwr.o")
INPUT("Z:\OpenTag\Repository\OpenTag_M2\Apps\Demo_Opmode\Proj_RIDE7\stm32f10x_rcc.o")
INPUT("Z:\OpenTag\Repository\OpenTag_M2\Apps\Demo_Opmode\Proj_RIDE7\stm32f10x_rtc.o")
INPUT("Z:\OpenTag\Repository\OpenTag_M2\Apps\Demo_Opmode\Proj_RIDE7\stm32f10x_sdio.o")
INPUT("Z:\OpenTag\Repository\OpenTag_M2\Apps\Demo_Opmode\Proj_RIDE7\stm32f10x_spi.o")
INPUT("Z:\OpenTag\Repository\OpenTag_M2\Apps\Demo_Opmode\Proj_RIDE7\stm32f10x_tim.o")
INPUT("Z:\OpenTag\Repository\OpenTag_M2\Apps\Demo_Opmode\Proj_RIDE7\stm32f10x_usart.o")
INPUT("Z:\OpenTag\Repository\OpenTag_M2\Apps\Demo_Opmode\Proj_RIDE7\stm32f10x_wwdg.o")
INPUT("Z:\OpenTag\Repository\OpenTag_M2\Apps\Demo_Opmode\Proj_RIDE7\otgd_fs_cal.o")
INPUT("Z:\OpenTag\Repository\OpenTag_M2\Apps\Demo_Opmode\Proj_RIDE7\otgd_fs_dev.o")
INPUT("Z:\OpenTag\Repository\OpenTag_M2\Apps\Demo_Opmode\Proj_RIDE7\otgd_fs_int.o")
INPUT("Z:\OpenTag\Repository\OpenTag_M2\Apps\Demo_Opmode\Proj_RIDE7\otgd_fs_pcd.o")
INPUT("Z:\OpenTag\Repository\OpenTag_M2\Apps\Demo_Opmode\Proj_RIDE7\usb_core.o")
INPUT("Z:\OpenTag\Repository\OpenTag_M2\Apps\Demo_Opmode\Proj_RIDE7\usb_init.o")
INPUT("Z:\OpenTag\Repository\OpenTag_M2\Apps\Demo_Opmode\Proj_RIDE7\usb_int.o")
INPUT("Z:\OpenTag\Repository\OpenTag_M2\Apps\Demo_Opmode\Proj_RIDE7\usb_mem.o")
INPUT("Z:\OpenTag\Repository\OpenTag_M2\Apps\Demo_Opmode\Proj_RIDE7\usb_regs.o")
INPUT("Z:\OpenTag\Repository\OpenTag_M2\Apps\Demo_Opmode\Proj_RIDE7\usb_sil.o")
INPUT("Z:\OpenTag\Repository\OpenTag_M2\Apps\Demo_Opmode\Proj_RIDE7\mpipe_uart_STM32F10x.o")
INPUT("Z:\OpenTag\Repository\OpenTag_M2\Apps\Demo_Opmode\Proj_RIDE7\mpipe_usbvcom_STM32F10x.o")
INPUT("Z:\OpenTag\Repository\OpenTag_M2\Apps\Demo_Opmode\Proj_RIDE7\platform_STM32F10x.o")
INPUT("Z:\OpenTag\Repository\OpenTag_M2\Apps\Demo_Opmode\Proj_RIDE7\system_stm32f10x.o")
INPUT("Z:\OpenTag\Repository\OpenTag_M2\Apps\Demo_Opmode\Proj_RIDE7\veelite_core_X2_STM32F10x.o")
INPUT("Z:\OpenTag\Repository\OpenTag_M2\Apps\Demo_Opmode\Proj_RIDE7\mlx73xxx_STM32.o")
INPUT("Z:\OpenTag\Repository\OpenTag_M2\Apps\Demo_Opmode\Proj_RIDE7\radio_MLX73290.o")
GROUP(
"std_sbrk_thumb.lib"
"smallprintf_thumb.a"
"libc.a"
"libm.a"

)
INCLUDE "stm32F1xx_1024+96.ld"
OUTPUT("Z:\OpenTag\Repository\OpenTag_M2\Apps\Demo_Opmode\Proj_RIDE7\MLXGateway.elf")


/*
!!! Primary linker script file generated automatically !!!
This file contains the input and output files names
It also includes the secondary/main linker script that is specified in the Ride options (default or custom)
*/

SEARCH_DIR(".")
SEARCH_DIR("B:\apps\app_7lan\proj_ride7\build")
SEARCH_DIR("C:\Program Files\Raisonance\Ride\Lib\ARM")
INPUT("B:\apps\app_7lan\proj_ride7\build\main.o")
INPUT("B:\apps\app_7lan\proj_ride7\build\dll_sig_rfinit.o")
INPUT("B:\apps\app_7lan\proj_ride7\build\dll_sig_rfterminate_2.o")
INPUT("B:\apps\app_7lan\proj_ride7\build\mpipe_sig_done.o")
INPUT("B:\apps\app_7lan\proj_ride7\build\network_sig_route.o")
INPUT("B:\apps\app_7lan\proj_ride7\build\sys_sig_panic.o")
INPUT("B:\apps\app_7lan\proj_ride7\build\sys_sig_powerdown_[stm32lp].o")
INPUT("B:\apps\app_7lan\proj_ride7\build\system_gulp.o")
INPUT("B:\apps\app_7lan\proj_ride7\build\system_hicculp.o")
INPUT("B:\apps\app_7lan\proj_ride7\build\alp_api_client.o")
INPUT("B:\apps\app_7lan\proj_ride7\build\alp_api_server.o")
INPUT("B:\apps\app_7lan\proj_ride7\build\alp_dashforth.o")
INPUT("B:\apps\app_7lan\proj_ride7\build\alp_filedata.o")
INPUT("B:\apps\app_7lan\proj_ride7\build\alp_logger.o")
INPUT("B:\apps\app_7lan\proj_ride7\build\alp_main.o")
INPUT("B:\apps\app_7lan\proj_ride7\build\alp_security.o")
INPUT("B:\apps\app_7lan\proj_ride7\build\alp_sensor.o")
INPUT("B:\apps\app_7lan\proj_ride7\build\auth.o")
INPUT("B:\apps\app_7lan\proj_ride7\build\buffers.o")
INPUT("B:\apps\app_7lan\proj_ride7\build\crc16.o")
INPUT("B:\apps\app_7lan\proj_ride7\build\crypto_aes128.o")
INPUT("B:\apps\app_7lan\proj_ride7\build\external.o")
INPUT("B:\apps\app_7lan\proj_ride7\build\m2_dll_task.o")
INPUT("B:\apps\app_7lan\proj_ride7\build\m2_encode.o")
INPUT("B:\apps\app_7lan\proj_ride7\build\m2_network.o")
INPUT("B:\apps\app_7lan\proj_ride7\build\m2_transport.o")
INPUT("B:\apps\app_7lan\proj_ride7\build\mpipe_task.o")
INPUT("B:\apps\app_7lan\proj_ride7\build\OT_utils.o")
INPUT("B:\apps\app_7lan\proj_ride7\build\OTAPI_logger.o")
INPUT("B:\apps\app_7lan\proj_ride7\build\OTAPI_tasker.o")
INPUT("B:\apps\app_7lan\proj_ride7\build\queue.o")
INPUT("B:\apps\app_7lan\proj_ride7\build\radio_task.o")
INPUT("B:\apps\app_7lan\proj_ride7\build\session.o")
INPUT("B:\apps\app_7lan\proj_ride7\build\veelite.o")
INPUT("B:\apps\app_7lan\proj_ride7\build\core_cm3.o")
INPUT("B:\apps\app_7lan\proj_ride7\build\usb_core.o")
INPUT("B:\apps\app_7lan\proj_ride7\build\usb_init.o")
INPUT("B:\apps\app_7lan\proj_ride7\build\usb_int.o")
INPUT("B:\apps\app_7lan\proj_ride7\build\usb_mem.o")
INPUT("B:\apps\app_7lan\proj_ride7\build\usb_regs.o")
INPUT("B:\apps\app_7lan\proj_ride7\build\usb_sil.o")
INPUT("B:\apps\app_7lan\proj_ride7\build\mpipe_uart_STM32L1xx.o")
INPUT("B:\apps\app_7lan\proj_ride7\build\mpipe_usbcdc_STM32L1xx.o")
INPUT("B:\apps\app_7lan\proj_ride7\build\platform_crc_STM32L1xx.o")
INPUT("B:\apps\app_7lan\proj_ride7\build\platform_gptim_STM32L1xx.o")
INPUT("B:\apps\app_7lan\proj_ride7\build\platform_isr_STM32L1xx.o")
INPUT("B:\apps\app_7lan\proj_ride7\build\platform_STM32L1xx.o")
INPUT("B:\apps\app_7lan\proj_ride7\build\startup_stm32l1xx_md.o")
INPUT("B:\apps\app_7lan\proj_ride7\build\stm32l1xx_flash.o")
INPUT("B:\apps\app_7lan\proj_ride7\build\veelite_core_EE_STM32L1xx.o")
INPUT("B:\apps\app_7lan\proj_ride7\build\radio_SPIRIT1.o")
INPUT("B:\apps\app_7lan\proj_ride7\build\SPIRIT1_STM32L1xx.o")
GROUP(
"std_sbrk_thumb.lib"
"smallprintf_thumb.a"
"libc.a"
"libm.a"

)
INCLUDE "B:\apps\demo_ponglt\proj_ride7\stm32l1xx_128_16.ld"
OUTPUT("B:\apps\app_7lan\proj_ride7\ponglt.elf")

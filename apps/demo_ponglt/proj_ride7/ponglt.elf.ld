
/*
!!! Primary linker script file generated automatically !!!
This file contains the input and output files names
It also includes the secondary/main linker script that is specified in the Ride options (default or custom)
*/

SEARCH_DIR(".")
SEARCH_DIR("R:\OpenTag\apps\demo_ponglt\proj_ride7")
SEARCH_DIR("C:\Program Files\Raisonance\Ride\Lib\ARM")
STARTUP("R:\OpenTag\apps\demo_ponglt\proj_ride7/build/startup_stm32l073xx.o")
INPUT("R:\OpenTag\apps\demo_ponglt\proj_ride7\main.o")
INPUT("R:\OpenTag\apps\demo_ponglt\proj_ride7\sys_sig_powerdown_[stm32lp].o")
INPUT("R:\OpenTag\apps\demo_ponglt\proj_ride7\dll_sig_rfinit.o")
INPUT("R:\OpenTag\apps\demo_ponglt\proj_ride7\dll_sig_rfterminate_2.o")
INPUT("R:\OpenTag\apps\demo_ponglt\proj_ride7\mpipe_sig_done.o")
INPUT("R:\OpenTag\apps\demo_ponglt\proj_ride7\network_sig_route.o")
INPUT("R:\OpenTag\apps\demo_ponglt\proj_ride7\sys_sig_panic.o")
INPUT("R:\OpenTag\apps\demo_ponglt\proj_ride7\SX127x_interface.o")
INPUT("R:\OpenTag\apps\demo_ponglt\proj_ride7\radio_rm2_patch.o")
INPUT("R:\OpenTag\apps\demo_ponglt\proj_ride7\radio_rm2.o")
INPUT("R:\OpenTag\apps\demo_ponglt\proj_ride7\usb_core.o")
INPUT("R:\OpenTag\apps\demo_ponglt\proj_ride7\usb_init.o")
INPUT("R:\OpenTag\apps\demo_ponglt\proj_ride7\usb_int.o")
INPUT("R:\OpenTag\apps\demo_ponglt\proj_ride7\usb_mem.o")
INPUT("R:\OpenTag\apps\demo_ponglt\proj_ride7\usb_regs.o")
INPUT("R:\OpenTag\apps\demo_ponglt\proj_ride7\usb_sil.o")
INPUT("R:\OpenTag\apps\demo_ponglt\proj_ride7\bgcrc8.o")
INPUT("R:\OpenTag\apps\demo_ponglt\proj_ride7\capi.o")
INPUT("R:\OpenTag\apps\demo_ponglt\proj_ride7\dll_task.o")
INPUT("R:\OpenTag\apps\demo_ponglt\proj_ride7\encode.o")
INPUT("R:\OpenTag\apps\demo_ponglt\proj_ride7\m2tasker.o")
INPUT("R:\OpenTag\apps\demo_ponglt\proj_ride7\network.o")
INPUT("R:\OpenTag\apps\demo_ponglt\proj_ride7\radio_task.o")
INPUT("R:\OpenTag\apps\demo_ponglt\proj_ride7\session.o")
INPUT("R:\OpenTag\apps\demo_ponglt\proj_ride7\transport.o")
INPUT("R:\OpenTag\apps\demo_ponglt\proj_ride7\stm32l0xx_hal.o")
INPUT("R:\OpenTag\apps\demo_ponglt\proj_ride7\stm32l0xx_hal_rcc.o")
INPUT("R:\OpenTag\apps\demo_ponglt\proj_ride7\stm32l0xx_hal_rcc_ex.o")
INPUT("R:\OpenTag\apps\demo_ponglt\proj_ride7\stm32l0xx_hal_pwr.o")
INPUT("R:\OpenTag\apps\demo_ponglt\proj_ride7\stm32l0xx_hal_pwr_ex.o")
INPUT("R:\OpenTag\apps\demo_ponglt\proj_ride7\stm32l0xx_hal_pcd.o")
INPUT("R:\OpenTag\apps\demo_ponglt\proj_ride7\stm32l0xx_hal_pcd_ex.o")
INPUT("R:\OpenTag\apps\demo_ponglt\proj_ride7\stm32l0xx_hal_gpio.o")
INPUT("R:\OpenTag\apps\demo_ponglt\proj_ride7\stm32l0xx_hal_flash.o")
INPUT("R:\OpenTag\apps\demo_ponglt\proj_ride7\stm32l0xx_hal_flash_ex.o")
INPUT("R:\OpenTag\apps\demo_ponglt\proj_ride7\otsys_veelite_X2.o")
INPUT("R:\OpenTag\apps\demo_ponglt\proj_ride7\otsys_veelite_EE.o")
INPUT("R:\OpenTag\apps\demo_ponglt\proj_ride7\otsys_mpipe_usbcdc.o")
INPUT("R:\OpenTag\apps\demo_ponglt\proj_ride7\otsys_mpipe_uart.o")
INPUT("R:\OpenTag\apps\demo_ponglt\proj_ride7\otlib_rand.o")
INPUT("R:\OpenTag\apps\demo_ponglt\proj_ride7\otlib_memcpy.o")
INPUT("R:\OpenTag\apps\demo_ponglt\proj_ride7\otlib_eax.o")
INPUT("R:\OpenTag\apps\demo_ponglt\proj_ride7\otlib_delay.o")
INPUT("R:\OpenTag\apps\demo_ponglt\proj_ride7\otlib_crc16.o")
INPUT("R:\OpenTag\apps\demo_ponglt\proj_ride7\io_SX127x.o")
INPUT("R:\OpenTag\apps\demo_ponglt\proj_ride7\io_SPIRIT1.o")
INPUT("R:\OpenTag\apps\demo_ponglt\proj_ride7\core_watchdog.o")
INPUT("R:\OpenTag\apps\demo_ponglt\proj_ride7\core_tasking.o")
INPUT("R:\OpenTag\apps\demo_ponglt\proj_ride7\core_main.o")
INPUT("R:\OpenTag\apps\demo_ponglt\proj_ride7\core_isr.o")
INPUT("R:\OpenTag\apps\demo_ponglt\proj_ride7\core_gptim.o")
INPUT("R:\OpenTag\apps\demo_ponglt\proj_ride7\core_errors.o")
INPUT("R:\OpenTag\apps\demo_ponglt\proj_ride7\startup_stm32l073xx.o")
INPUT("R:\OpenTag\apps\demo_ponglt\proj_ride7\alp_api_client.o")
INPUT("R:\OpenTag\apps\demo_ponglt\proj_ride7\alp_api_server.o")
INPUT("R:\OpenTag\apps\demo_ponglt\proj_ride7\alp_dashforth.o")
INPUT("R:\OpenTag\apps\demo_ponglt\proj_ride7\alp_filedata.o")
INPUT("R:\OpenTag\apps\demo_ponglt\proj_ride7\alp_logger.o")
INPUT("R:\OpenTag\apps\demo_ponglt\proj_ride7\alp_main.o")
INPUT("R:\OpenTag\apps\demo_ponglt\proj_ride7\alp_security.o")
INPUT("R:\OpenTag\apps\demo_ponglt\proj_ride7\alp_sensor.o")
INPUT("R:\OpenTag\apps\demo_ponglt\proj_ride7\alp_tmpl.o")
INPUT("R:\OpenTag\apps\demo_ponglt\proj_ride7\auth.o")
INPUT("R:\OpenTag\apps\demo_ponglt\proj_ride7\buffers.o")
INPUT("R:\OpenTag\apps\demo_ponglt\proj_ride7\crc16.o")
INPUT("R:\OpenTag\apps\demo_ponglt\proj_ride7\crypto.o")
INPUT("R:\OpenTag\apps\demo_ponglt\proj_ride7\logger.o")
INPUT("R:\OpenTag\apps\demo_ponglt\proj_ride7\queue.o")
INPUT("R:\OpenTag\apps\demo_ponglt\proj_ride7\trigger.o")
INPUT("R:\OpenTag\apps\demo_ponglt\proj_ride7\utils.o")
INPUT("R:\OpenTag\apps\demo_ponglt\proj_ride7\veelite.o")
INPUT("R:\OpenTag\apps\demo_ponglt\proj_ride7\veelite[32].o")
INPUT("R:\OpenTag\apps\demo_ponglt\proj_ride7\external.o")
INPUT("R:\OpenTag\apps\demo_ponglt\proj_ride7\mpipe_task.o")
INPUT("R:\OpenTag\apps\demo_ponglt\proj_ride7\otat_task.o")
INPUT("R:\OpenTag\apps\demo_ponglt\proj_ride7\sysqueue.o")
INPUT("R:\OpenTag\apps\demo_ponglt\proj_ride7\system_gulp.o")
INPUT("R:\OpenTag\apps\demo_ponglt\proj_ride7\system_hicculp.o")
INPUT("R:\OpenTag\apps\demo_ponglt\proj_ride7\time.o")
INPUT("R:\OpenTag\apps\demo_ponglt\proj_ride7\oteax.o")
INPUT("R:\OpenTag\apps\demo_ponglt\proj_ride7\aestab.o")
INPUT("R:\OpenTag\apps\demo_ponglt\proj_ride7\aeskey.o")
INPUT("R:\OpenTag\apps\demo_ponglt\proj_ride7\aescrypt.o")
INPUT("R:\OpenTag\apps\demo_ponglt\proj_ride7\aes_modes_m2.o")
INPUT("C:\Program Files\Raisonance\Ride\Lib\ARM\__default_empty_libc_init_array.o")
GROUP(
"smallprintf_thumb.a"
"libc_nano.a"
"libm.a"

)
INCLUDE "R:\OpenTag\apps\demo_ponglt\proj_ride7/../../_common/linker/stm32l0xx_192_20.ld"
PROVIDE ( _Minimum_Stack_Size = 0x20 );
PROVIDE ( malloc_getpagesize_P = 0x1000 );
OUTPUT("R:\OpenTag\apps\demo_ponglt\proj_ride7\ponglt.elf")

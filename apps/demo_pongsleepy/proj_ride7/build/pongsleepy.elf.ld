
/*
!!! Primary linker script file generated automatically !!!
This file contains the input and output files names
It also includes the secondary/main linker script that is specified in the Ride options (default or custom)
*/

SEARCH_DIR(".")
SEARCH_DIR("R:\OpenTag\apps\demo_pongsleepy\proj_ride7\build")
SEARCH_DIR("C:\Program Files\Raisonance\Ride\Lib\ARM")
STARTUP("R:\OpenTag\apps\demo_pongsleepy\proj_ride7/build/startup_stm32l1xx_md.o")
INPUT("R:\OpenTag\apps\demo_pongsleepy\proj_ride7\build\main.o")
INPUT("R:\OpenTag\apps\demo_pongsleepy\proj_ride7\build\sys_sig_powerdown_[stm32lp].o")
INPUT("R:\OpenTag\apps\demo_pongsleepy\proj_ride7\build\dll_sig_rfinit.o")
INPUT("R:\OpenTag\apps\demo_pongsleepy\proj_ride7\build\dll_sig_rfterminate_2.o")
INPUT("R:\OpenTag\apps\demo_pongsleepy\proj_ride7\build\mpipe_sig_done.o")
INPUT("R:\OpenTag\apps\demo_pongsleepy\proj_ride7\build\network_sig_route.o")
INPUT("R:\OpenTag\apps\demo_pongsleepy\proj_ride7\build\sys_sig_panic.o")
INPUT("R:\OpenTag\apps\demo_pongsleepy\proj_ride7\build\radio_rm2.o")
INPUT("R:\OpenTag\apps\demo_pongsleepy\proj_ride7\build\radio_rm2_patch.o")
INPUT("R:\OpenTag\apps\demo_pongsleepy\proj_ride7\build\SPIRIT1_interface.o")
INPUT("R:\OpenTag\apps\demo_pongsleepy\proj_ride7\build\usb_core.o")
INPUT("R:\OpenTag\apps\demo_pongsleepy\proj_ride7\build\usb_init.o")
INPUT("R:\OpenTag\apps\demo_pongsleepy\proj_ride7\build\usb_int.o")
INPUT("R:\OpenTag\apps\demo_pongsleepy\proj_ride7\build\usb_mem.o")
INPUT("R:\OpenTag\apps\demo_pongsleepy\proj_ride7\build\usb_regs.o")
INPUT("R:\OpenTag\apps\demo_pongsleepy\proj_ride7\build\usb_sil.o")
INPUT("R:\OpenTag\apps\demo_pongsleepy\proj_ride7\build\capi.o")
INPUT("R:\OpenTag\apps\demo_pongsleepy\proj_ride7\build\dll_task.o")
INPUT("R:\OpenTag\apps\demo_pongsleepy\proj_ride7\build\encode.o")
INPUT("R:\OpenTag\apps\demo_pongsleepy\proj_ride7\build\m2tasker.o")
INPUT("R:\OpenTag\apps\demo_pongsleepy\proj_ride7\build\network.o")
INPUT("R:\OpenTag\apps\demo_pongsleepy\proj_ride7\build\radio_task.o")
INPUT("R:\OpenTag\apps\demo_pongsleepy\proj_ride7\build\session.o")
INPUT("R:\OpenTag\apps\demo_pongsleepy\proj_ride7\build\transport.o")
INPUT("R:\OpenTag\apps\demo_pongsleepy\proj_ride7\build\core_errors.o")
INPUT("R:\OpenTag\apps\demo_pongsleepy\proj_ride7\build\core_gptim.o")
INPUT("R:\OpenTag\apps\demo_pongsleepy\proj_ride7\build\core_isr.o")
INPUT("R:\OpenTag\apps\demo_pongsleepy\proj_ride7\build\core_main.o")
INPUT("R:\OpenTag\apps\demo_pongsleepy\proj_ride7\build\core_tasking.o")
INPUT("R:\OpenTag\apps\demo_pongsleepy\proj_ride7\build\core_watchdog.o")
INPUT("R:\OpenTag\apps\demo_pongsleepy\proj_ride7\build\io_SPIRIT1.o")
INPUT("R:\OpenTag\apps\demo_pongsleepy\proj_ride7\build\otlib_delay.o")
INPUT("R:\OpenTag\apps\demo_pongsleepy\proj_ride7\build\otlib_eax.o")
INPUT("R:\OpenTag\apps\demo_pongsleepy\proj_ride7\build\otlib_memcpy.o")
INPUT("R:\OpenTag\apps\demo_pongsleepy\proj_ride7\build\otlib_rand.o")
INPUT("R:\OpenTag\apps\demo_pongsleepy\proj_ride7\build\otsys_mpipe_uart.o")
INPUT("R:\OpenTag\apps\demo_pongsleepy\proj_ride7\build\otsys_mpipe_usbcdc.o")
INPUT("R:\OpenTag\apps\demo_pongsleepy\proj_ride7\build\otsys_veelite_EE.o")
INPUT("R:\OpenTag\apps\demo_pongsleepy\proj_ride7\build\stm32l1xx_flash.o")
INPUT("R:\OpenTag\apps\demo_pongsleepy\proj_ride7\build\stm32l1xx_pwr.o")
INPUT("R:\OpenTag\apps\demo_pongsleepy\proj_ride7\build\stm32l1xx_rcc.o")
INPUT("R:\OpenTag\apps\demo_pongsleepy\proj_ride7\build\alp_api_client.o")
INPUT("R:\OpenTag\apps\demo_pongsleepy\proj_ride7\build\alp_api_server.o")
INPUT("R:\OpenTag\apps\demo_pongsleepy\proj_ride7\build\alp_dashforth.o")
INPUT("R:\OpenTag\apps\demo_pongsleepy\proj_ride7\build\alp_filedata.o")
INPUT("R:\OpenTag\apps\demo_pongsleepy\proj_ride7\build\alp_logger.o")
INPUT("R:\OpenTag\apps\demo_pongsleepy\proj_ride7\build\alp_main.o")
INPUT("R:\OpenTag\apps\demo_pongsleepy\proj_ride7\build\alp_security.o")
INPUT("R:\OpenTag\apps\demo_pongsleepy\proj_ride7\build\alp_sensor.o")
INPUT("R:\OpenTag\apps\demo_pongsleepy\proj_ride7\build\alp_tmpl.o")
INPUT("R:\OpenTag\apps\demo_pongsleepy\proj_ride7\build\auth.o")
INPUT("R:\OpenTag\apps\demo_pongsleepy\proj_ride7\build\buffers.o")
INPUT("R:\OpenTag\apps\demo_pongsleepy\proj_ride7\build\crc16.o")
INPUT("R:\OpenTag\apps\demo_pongsleepy\proj_ride7\build\crypto.o")
INPUT("R:\OpenTag\apps\demo_pongsleepy\proj_ride7\build\logger.o")
INPUT("R:\OpenTag\apps\demo_pongsleepy\proj_ride7\build\queue.o")
INPUT("R:\OpenTag\apps\demo_pongsleepy\proj_ride7\build\utils.o")
INPUT("R:\OpenTag\apps\demo_pongsleepy\proj_ride7\build\veelite.o")
INPUT("R:\OpenTag\apps\demo_pongsleepy\proj_ride7\build\trigger.o")
INPUT("R:\OpenTag\apps\demo_pongsleepy\proj_ride7\build\external.o")
INPUT("R:\OpenTag\apps\demo_pongsleepy\proj_ride7\build\mpipe_task.o")
INPUT("R:\OpenTag\apps\demo_pongsleepy\proj_ride7\build\system_gulp.o")
INPUT("R:\OpenTag\apps\demo_pongsleepy\proj_ride7\build\system_hicculp.o")
INPUT("R:\OpenTag\apps\demo_pongsleepy\proj_ride7\build\time.o")
GROUP(
"std_sbrk_thumb.lib"
"smallprintf_thumb.a"
"libc.a"
"libm.a"

)
INCLUDE "R:\OpenTag\apps\demo_pongsleepy\proj_ride7/../../_common/linker/stm32l1xx_128_16.ld"
OUTPUT("R:\OpenTag\apps\demo_pongsleepy\proj_ride7\build\pongsleepy.elf")
